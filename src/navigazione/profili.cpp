#include "profili.h"

/* ELEMENTI DEL DATABASE */

profilo_t sinusoide = {
    "Sinusoide",
    1000,
    NULL,
    NULL,
    {127,128,129,129,130,131,132,133,133,134,135,136,137,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126,}
};

profilo_t rampa = {
    "Rampa",
    256,
    NULL,
    NULL,
    {0,1,2,3,4,5,6,7,8,9,10,11,12,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254,255}
};

profilo_t test = {
        "Nome lungolungolungolungo",
        5,
        NULL,
        NULL,
        {125, 125, 125, 125, 125}
    };

profilo_t test2 = {
        "15Caratteri_888",
        13,
        NULL,
        NULL,
        {125, 125, 125, 125, 125, 0, 0, 0, 0, 0, 0, 0, 0}
    };

/* IMPORTANTE! SE AGGIUNGI PROFILI QUI SOPRA, RICORDA DI MODIFICARE LA FUNZIONE */
/* caricaProfiliBase() PER AGGIUNGERLI AL DATABASE INIZIALE */


/* FUNZIONI DI GESTIONE DELLA LISTA DEI PROFILI */

bool appendProfilo(profilo_t *database, profilo_t *nuovoProfilo) {
    
    profilo_t *ptr = database;

    if (ptr->pre != NULL)
    {
        Serial.println("ERROR: non è stato passato il puntatore alla lista");
        return false;
    }

    while (ptr->next != NULL)
    {
        ptr = ptr->next;
    }

    nuovoProfilo->pre = ptr;
    nuovoProfilo->next = NULL;    // sarebbe già NULL di default
    ptr->next = nuovoProfilo;

    return true;
    
}

bool cancellaProfilo(profilo_t *database, profilo_t daCancellare) {

    profilo_t *ptr = database;

    if (ptr->pre != NULL)
    {
        Serial.println("ERROR: non è stato passato il puntatore alla lista");
        return false;
    }

    String target = daCancellare.nome;

    while ((ptr->next)->nome != target)
    {
        ptr = ptr->next;
    }

    // TODO finire

    return false;
}

bool caricaProfiliBase(profilo_t *database) {

    bool esito = true;
    esito &= appendProfilo(database, &sinusoide);
    esito &= appendProfilo(database, &rampa);
    esito &= appendProfilo(database, &test);
    esito &= appendProfilo(database, &test2);

    // esito &= appendProfilo(database, &<nuovoProfilo>);
    // append per ogni profilo

    return esito;   // se tutti gli append vanno a buon fine esito è true
}

profilo_t *caricaDatabase(profilo_t *ptrDatabase) {
    if (caricaProfiliBase(ptrDatabase) == true)
    {
        // TODO if(caricaProfiliUtente(ptrDatabase) == true)
        Serial.println("Database caricato correttamente");
        return ptrDatabase;
    }
    else
    {
        Serial.println("ERRORE in caricaDatabaseProfili()");
        return NULL;
    }
}

void visualizzaDatabase(profilo_t *ptrDatabase) {

    profilo_t *ptrNavigazione = ptrDatabase; // ? necessario

    if (ptrNavigazione->pre != NULL)
    {
        Serial.println("Non è stato passato il puntatore alla lista");
    }

    while (ptrNavigazione != NULL)
    {
        Serial.print(ptrNavigazione->nome);
        Serial.printf(", size: %u", ptrNavigazione->size);
        Serial.println();
        ptrNavigazione = ptrNavigazione->next;
    }
    
    Serial.println();
    
}

profilo_t *cercaProfilo(profilo_t *ptrNavigazione, String nomeProfilo) {

    if (ptrNavigazione->pre != NULL)
    {
        Serial.println("Non è stato passato il puntatore alla lista");
        return NULL;
    }
    
    while (ptrNavigazione != NULL)
    {
        if (ptrNavigazione->nome == nomeProfilo)
        {
            return ptrNavigazione;
        }

        ptrNavigazione = ptrNavigazione->next;
        
    }

    return NULL;
    
}